## conf/layer.conf
```bitbake
# We have a conf and classes directory, add to BBPATH
BBPATH .= ":${LAYERDIR}"

# We have recipes-* directories, add to BBFILES
BBFILES += "${LAYERDIR}/recipes-*/*/*.bb \
            ${LAYERDIR}/recipes-*/*/*.bbappend"

BBFILE_COLLECTIONS += "meta-johnblue"
BBFILE_PATTERN_meta-johnblue = "^${LAYERDIR}/"
BBFILE_PRIORITY_meta-johnblue = "10"

LAYERDEPENDS_meta-johnblue = "core phosphor-layer aspeed-layer meta-evb-ast2600"

LAYERSERIES_COMPAT_meta-johnblue = "wrynose whinlatter"
```

## conf/machine/johnblue.conf
```bitbake
#@TYPE: Machine
#@NAME: johnblue
#@DESCRIPTION: Custom QEMU BMC for I2C -> MCTP -> PLDM development (AST2600 based)

# Inherit everything from the upstream AST2600 EVB:
# - linux-aspeed kernel, u-boot-aspeed-sdk, AST2600 QEMU model support,
#   FLASH_SIZE, SERIAL_CONSOLES, and mctp.inc (DISTRO_FEATURES += "mctp")
require conf/machine/evb-ast2600.conf

# Disable FIT image signing — evb-ast2600.conf already sets SOCSEC_SIGN_ENABLE=0
# but be explicit so this is clear for QEMU development use.
SOCSEC_SIGN_ENABLE = "0"

# Enable PLDM distro feature.
# pldm.inc also requires mctp.inc, so both pldm and mctp are active.
# This enables transport-af-mctp PACKAGECONFIG in the pldm recipe
# via the :df-mctp DISTROOVERRIDES (set by mctp.inc).
include conf/distro/include/pldm.inc

# Pull mctp userspace daemon and pldm daemon into the image.
MACHINE_EXTRA_RRECOMMENDS += " \
    mctp \
    pldm \
"

# Default port forwarding for QEMU slirp networking.
# SSH: host:2222 -> BMC:22 | HTTPS: host:4433 -> BMC:443 | IPMI: host:6233 -> BMC:623
QB_SLIRP_OPT = "-netdev user,id=net0,hostfwd=tcp::2222-:22,hostfwd=tcp::4433-:443,hostfwd=udp::6233-:623"
```
